## yocto/meta-ba20-bsp/conf/distro/fsl-imx-fides.conf
```bitbake
# i.MX DISTRO for the FrameBuffer Qt graphical backend.

include conf/distro/include/fsl-imx-base.inc
include conf/distro/include/fsl-imx-preferred-env.inc

DISTRO = "fsl-imx-fides"
DISTRO_VERSION = "0.1.0"
DISTRO_NAME = "Fides Distro"

# Remove conflicting backends.
DISTRO_FEATURES:remove = "directfb x11 "
DISTRO_FEATURES:append = " pam usrmerge systemd"

GPULESS_FEATURES = "wayland vulkan webengine"
DISTRO_FEATURES:remove:mx93-nxp-bsp = "${GPULESS_FEATURES}"
DISTRO_FEATURES:remove = "rust"

# Need gles2 for opengl
# Needed because it is enabled in imx93, and it needs to be disabled if building in opengl-less distro: https://code.qt.io/cgit/yocto/meta-qt6.git/tree/recipes-qt/packagegroups/packagegroup-qt6-addons.bb
PACKAGECONFIG:append:mx93-nxp-bsp:pn-qtbase = " gles2 kms linuxfb"

# Need opengl for KMS and dumb buffer
PACKAGECONFIG:remove:mx93-nxp-bsp:pn-qtbase = "no-opengl" 

# We remove gbm, not kms because it is required for dumb buffer support
PACKAGECONFIG:remove:mx93-nxp-bsp:pn-qtbase = "gbm" 

PACKAGECONFIG:append:pn-gstreamer1.0-plugins-ugly = " x264"
LICENSE_FLAGS_ACCEPTED = "commercial"

TOOLCHAIN_TARGET_TASK += "libubootenv"
```

## yocto/meta-ba20-bsp/conf/layer.conf
```bitbake
# We have a conf and classes directory, add to BBPATH
BBPATH .= ":${LAYERDIR}"

# We have recipes-* directories, add to BBFILES
BBFILES += "${LAYERDIR}/recipes-*/*/*.bb \
            ${LAYERDIR}/recipes-*/*/*.bbappend"

BBFILE_COLLECTIONS += "meta-ba20-bsp"
BBFILE_PATTERN_meta-ba20-bsp = "^${LAYERDIR}/"
BBFILE_PRIORITY_meta-ba20-bsp = "100"

LAYERDEPENDS_meta-ba20-bsp = "core freescale-layer"
LAYERSERIES_COMPAT_meta-ba20-bsp = "scarthgap"
```

## yocto/meta-ba20-bsp/conf/machine/imx93evk.conf
```bitbake
#@TYPE: Machine
#@NAME: i.MX 93 Consolidated rootfs machine
#@SOC: i.MX93
#@DESCRIPTION: A Consolidated machine configuration for i.MX 93 LPDDR4x and LPDDR4 EVK/QSB, see Important Note below
#@MAINTAINER: Jun Zhu <junzhu@nxp.com>

#        ** Important Note **
# This machine generates an image contain the bootloader of 11x11 LPDDR4x EVK, Kernel, and rootfs, plus the DTBs of
# 11x11 LPDDR4x EVK, 14x14x LPDDR4 EVK and 9x9 LPDDR4 QSB boards. The resulting image can be used for 11x11 LPDDR4x EVK directly,
# and it can be manually converted for other EVK or QSB following the instructions in the User Guide - Consolidated Machines section.
# For users of all of EVK/QSB variants, this can save build time and space. For most users, the dedicated machines
# imx93-11x11-lpddr4x-evk.conf, imx93-14x14-lpddr4x-evk.conf and imx93-9x9-lpddr4-qsb.conf should be used for simplicity.

MACHINEOVERRIDES =. "imx93-11x11-lpddr4x-evk:"
require conf/machine/imx93-11x11-lpddr4x-evk.conf

# Include device trees for other boards for internal test
KERNEL_DEVICETREE += " \
        freescale/imx93-11x11-evk-edt-lvds-panel.dtb \
"

IMX_BOOT_SEEK:append:use-nxp-bsp = "32"
APPEND += " console=ttyLP6,115200 earlycon"
```
